## CMakeLists.txt
```
# Find Zephyr. This also loads Zephyr's build system.
cmake_minimum_required(VERSION 3.20.0)
# set(ZEPHYR_EXTRA_MODULES ${CMAKE_CURRENT_SOURCE_DIR}/../../)

find_package(Zephyr)
project(test)

# Add your source file to the "app" target. This must come after
# find_package(Zephyr) which defines the target.
target_sources(app PRIVATE src/main.c)
```

## Kconfig
```
source "Kconfig.zephyr"

rsource "../../Kconfig"
```

## prj.conf
```kconfig
# nothing here

# console
CONFIG_CONSOLE=y
CONFIG_UART_CONSOLE=y

# SHELL
CONFIG_SHELL=y
CONFIG_GPIO_SHELL=y
CONFIG_FLASH_SHELL=y
CONFIG_SHELL_PROMPT_UART="m031:~$ "

# MCUboot
# CONFIG_BOOTLOADER_MCUBOOT=y
# CONFIG_MCUBOOT_GENERATE_UNSIGNED_IMAGE=y
```

## src/main.c
```c
#include <stdio.h>
#include <zephyr/kernel.h>
#include <zephyr/drivers/gpio.h>

/* 1000 msec = 1 sec */
#define SLEEP_TIME_MS   1000

/* The devicetree node identifier for the "led0" alias. */
#define LED0_NODE DT_ALIAS(led0)

/*
 * A build error on this line means your board is unsupported.
 * See the sample documentation for information on how to fix this.
 */
static const struct gpio_dt_spec led = GPIO_DT_SPEC_GET(LED0_NODE, gpios);

int main(void) {
    int ret;
	bool led_state = true;

	if (!gpio_is_ready_dt(&led)) {
		return 0;
	}

	ret = gpio_pin_configure_dt(&led, GPIO_OUTPUT_ACTIVE);
	if (ret < 0) {
		return 0;
	}

    printf("Hello World!\n");

    while (1) {
		gpio_pin_set_dt(&led, 0);
		k_msleep(SLEEP_TIME_MS);
		// k_busy_wait(1000000);
		printf("LED state: %s\n", "ON");

		gpio_pin_set_dt(&led, 1);
		k_msleep(SLEEP_TIME_MS);
		// k_busy_wait(1000000);
		printf("LED state: %s\n", "OFF");
    }

    return 0;
}
```
