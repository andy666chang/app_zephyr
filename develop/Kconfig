## develop/Kconfig
```kconfig
menu "Develop Configuration"



endmenu

rsource "drivers/Kconfig"
rsource "hal/Kconfig"
```

## develop/boards/arm/dk_nrf52832/Kconfig
```kconfig
# nRF52 DK board configuration

# Copyright (c) 2016 Nordic Semiconductor ASA
# SPDX-License-Identifier: Apache-2.0

config BOARD_ENABLE_DCDC
	bool "DCDC mode"
	select SOC_DCDC_NRF52X
	default n
	depends on BOARD_DK_NRF52832
```

## develop/boards/arm/linkit_nrf52832/Kconfig.defconfig
```kconfig
# nRF52 DK NRF52832 board configuration

# Copyright (c) 2016 Nordic Semiconductor ASA
# SPDX-License-Identifier: Apache-2.0

if BOARD_LINKIT_NRF52832

config BOARD
	default "linkit_nrf52832"

config BT_CTLR
	default BT

endif # BOARD_LINKIT_NRF52832
```

## develop/boards/arm/nuvoton_m031/Kconfig.board
```kconfig
config BOARD_NUVOTON_M031
	bool "NUVOTON M031 Development Board"
	depends on SOC_M031
```

## develop/boards/arm/nuvoton_m031/Kconfig.defconfig
```kconfig
if BOARD_NUVOTON_M031

config BOARD
	default "nuvoton_m031"

endif # BOARD_NUVOTON_M031
```

## develop/boards/arm/nuvoton_m031/nuvoton_m031_defconfig
```kconfig
# SPDX-License-Identifier: Apache-2.0

CONFIG_SOC_SERIES_M03X=y
CONFIG_SOC_M031TD=y

# CONFIG_CLOCK_CONTROL=y
# CONFIG_CLOCK_CTRL_M031=y
CONFIG_SYS_CLOCK_HW_CYCLES_PER_SEC=48000000
CONFIG_SYS_CLOCK_EXISTS=n

# Enable GPIO and pinctrl drivers
CONFIG_GPIO=y
# CONFIG_PINCTRL=y

# enable uart driver
# CONFIG_SERIAL=y

# console
# CONFIG_CONSOLE=y
# CONFIG_UART_CONSOLE=y
```

## develop/drivers/clock_control/Kconfig.m031
```kconfig
menuconfig CLOCK_CTRL_M03X
	bool "CLOCK_CTRL Driver for M03X family of MCUs"
	default y
	depends on SOC_FAMILY_M03X
	help
	  Enable CLOCK_CTRL driver for M03X MCUs

if CLOCK_CTRL_M03X
	
endif # CLOCK_CTRL_M03X
```

## develop/drivers/flash/Kconfig
```kconfig
if FLASH

module = FLASH
module-str = flash
source "subsys/logging/Kconfig.template.log_config"

rsource "./Kconfig.*"

endif # FLASH
```

## develop/drivers/flash/Kconfig.m031
```kconfig
menuconfig FLASH_M031
	bool "FLASH Driver for M031 family of MCUs"
    default y
	depends on SOC_FAMILY_M03X
	select FLASH_HAS_PAGE_LAYOUT
	select FLASH_HAS_DRIVER_ENABLED
	select M031_FMC
	help
	  Enable FLASH driver for M031 MCUs
```

## develop/drivers/gpio/Kconfig.m031
```kconfig
menuconfig GPIO_M031
	bool "GPIO Driver for M031 family of MCUs"
    default y
	depends on SOC_FAMILY_M03X
	select M031_GPIO
	help
	  Enable GPIO driver for M031 MCUs
```

## develop/drivers/pinctrl/Kconfig
```kconfig
if PINCTRL

module = PINCTRL
module-str = PINCTRL
source "subsys/logging/Kconfig.template.log_config"

rsource "./Kconfig.*"

endif # PINCTRL
```

## develop/drivers/pinctrl/Kconfig.m031
```kconfig
config PINCTRL_M031
	bool "PINCTRL Driver for M031 family of MCUs"
    default y
	depends on PINCTRL
	depends on SOC_FAMILY_M03X
```

## develop/drivers/serial/Kconfig
```kconfig
if SERIAL

module = SERIAL
module-str = SERIAL
source "subsys/logging/Kconfig.template.log_config"

rsource "./Kconfig.*"

endif # SERIAL
```

## develop/drivers/serial/Kconfig.m031
```kconfig
menuconfig UART_M031
	bool "UART Driver for M031 family of MCUs"
    default y
	depends on SOC_FAMILY_M03X
    select SERIAL_HAS_DRIVER
	select M031_UART
	help
	  Enable UART driver for M031 MCUs
```

## develop/dts/bindings/flash/nuvoton,m031-flash-controller.yml
```yaml
description: |
  M031 controller

compatible: "nuvoton,m031-flash-controller"

include: flash-controller.yaml
```

## develop/dts/bindings/gpio/nuvoton,m031-gpio.yaml
```yaml
description: Nuvoton NuMicro GPIO node

compatible: "nuvoton,m031-gpio"

include: [gpio-controller.yaml, base.yaml]

properties:
  reg:
    required: true

  "#gpio-cells":
    const: 2

gpio-cells:
  - pin
  - flags
```

## develop/dts/bindings/pinctrl/nuvoton,m031-pinctrl.yaml
```yaml
description: |
  Nuvoton M031 pinctrl node. This node will define pin configurations in pin groups,
  and has the 'pinctrl' node identifier in the SOC's devicetree. Each group
  within the pin configuration defines the pin configuration for a peripheral,
  and each numbered subgroup in the pin group defines all the pins for that
  peripheral with the same configuration properties. The 'pinmux' property in
  a group selects the pins to be configured, and the remaining properties set
  configuration values for those pins. Here is an example group for UART0 pins:

  uart0_default: uart0_default {
    group0 {
      pinmux = <UART0_RXD_PB12>, <UART0_TXD_PB13>;
    };
  };

compatible: "nuvoton,m031-pinctrl"

include: base.yaml

properties:
  reg:
    required: true

child-binding:
  description: NuMicro pin controller pin group
  child-binding:
    description: |
      NuMicro pin controller pin configuration node
    include:
      - name: pincfg-node.yaml
        property-allowlist:
          - drive-open-drain
          - input-disable
    properties:
      pinmux:
        required: true
        type: array
        description: |
          Pin mux selections for this group. See the SoC level pinctrl dtsi file
          for a defined list of these options.
      input-debounce:
        type: boolean
        description: |
          enable the input debounce function
```

## develop/dts/bindings/serial/nuvoton,m031-uart.yaml
```yaml
description: NUVOTON M031 FAMILY UART

compatible: "nuvoton,m031-uart"

include: [uart-controller.yaml, pinctrl-device.yaml]

properties:
  reg:
    required: true

  pinctrl-0:
    required: true
```

## develop/hal/Kconfig
```kconfig
config M031_LIBRARY
	bool
	depends on SOC_SERIES_M031

if M031_LIBRARY

config M031_ADC
    bool 

config M031_CRC
    bool 

config M031_EINT
    bool 

config M031_FMC
    bool 

config M031_GPIO
    bool 

config M031_I2C
    bool 

config M031_IWDT
    bool 

config M031_SPI
    bool 

config M031_TMR
    bool 

config M031_USART
    bool 

config M031_WWDT
    bool 

endif # M031_LIBRARY
```

## develop/soc/arm/nuvoton_m03x/Kconfig
```kconfig
config SOC_FAMILY_M03X
	bool
	select PLATFORM_SPECIFIC_INIT
	select BUILD_OUTPUT_HEX
	select M031_LIBRARY

if SOC_FAMILY_M03X

config SOC_FAMILY
	string
	default "nuvoton_m03x"

rsource "./*/Kconfig.soc"

endif # SOC_FAMILY_M03X
```

## develop/soc/arm/nuvoton_m03x/m031/Kconfig.defconfig.m031
```kconfig
if SOC_M031TD || SOC_M031LE

config SOC
	default "m03x"

config NUM_IRQS
	default 32

endif # SOC_M031TD || SOC_M031LE
```

## develop/soc/arm/nuvoton_m03x/m031/Kconfig.defconfig.series
```kconfig
if SOC_SERIES_M03X

config M031_TD
	bool

config M031_LE
	bool

rsource "Kconfig.defconfig.m031"

config SOC_SERIES
	default "m031"

endif # SOC_SERIES_M03X
```

## develop/soc/arm/nuvoton_m03x/m031/Kconfig.series
```kconfig
config SOC_SERIES_M03X
	bool "Nuvoton M03X Series MCU"
	select ARM
	select CPU_CORTEX_M0
	select SOC_FAMILY_M03X
	help
	  Enable support for NUVOTON M03X MCU series
```
