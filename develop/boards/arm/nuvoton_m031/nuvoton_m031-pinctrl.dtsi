/*
 * Copyright (c) 2022 SEAL AG
 *
 * SPDX-License-Identifier: Apache-2.0
 */

#include <zephyr/dt-bindings/pinctrl/m03x-pinctrl.h>

&pinctrl {
	uart0_default: uart0_default {
		group0 {
			pinmux = <UART0_RXD_PB12>, <UART0_TXD_PB13>;
		};
	};
};
